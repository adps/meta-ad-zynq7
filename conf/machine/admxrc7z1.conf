## conf/machine/admxrc7z1.conf
```bitbake
#@TYPE: Machine
#@NAME: admxrc7z1
#@DESCRIPTION: Machine support for admxrc7z1.

require conf/machine/include/tune-zynq.inc
require conf/machine/include/machine-admxrc7z-default.inc
require conf/machine/include/machine-admxrc7z-board.inc

IMAGE_FSTYPES = "ext2 cpio.gz cpio.gz.u-boot"

# admxrc7z1 machine definition known by Xilinx UBOOT
## Xilinx does not know about us yet!
# UBOOT_MACHINE = "admxrc7z1_config"

SERIAL_CONSOLE = "115200 ttyPS0"

MACHINE_DEVICETREE := " \
		admxrc7z1/admxrc7z1-board.dtsi \
		admxrc7z1/admxrc7z1.dts \
		"

MACHINE_KCONFIG := "common/linux/admxrc7z.cfg"

MACHINE_FEATURES := ""

# Let the kernel know we don't support an RTC
MACHINE_FEATURES_BACKFILL_CONSIDERED := "rtc"
```
